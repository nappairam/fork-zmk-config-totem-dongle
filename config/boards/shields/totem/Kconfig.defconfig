## config/boards/shields/totem/Kconfig.defconfig
```kconfig
# Copyright (c) 2022 The ZMK Contributors
# SPDX-License-Identifier: MIT

if SHIELD_TOTEM_DONGLE || SHIELD_TOTEM_DISPLAY_DONGLE

config ZMK_KEYBOARD_NAME
    default "TOTEM"

config ZMK_SPLIT_ROLE_CENTRAL
    default y

config ZMK_USB
    default y

config ZMK_USB_BOOT
    default y

config ZMK_STUDIO
    default y

config ZMK_SLEEP
    default n

config ZMK_SPLIT_BLE_CENTRAL_PERIPHERALS
    default 2

choice BT_CTLR_TX_PWR
    default BT_CTLR_TX_PWR_PLUS_8
endchoice

endif

if SHIELD_TOTEM_LEFT || SHIELD_TOTEM_RIGHT || SHIELD_TOTEM_DONGLE || SHIELD_TOTEM_DISPLAY_DONGLE

config ZMK_SPLIT
    default y

config ZMK_BLE
    default y

endif
```
